/dts-v1/;
 
/ {
	overlay-name = "qdmabuf";
	jetson-header-name = "Jetson 40pin Header";
	compatible = "nvidia,p3768-0000+p3767-0001";
 
	fragment@0 {
		target-path = "/";
		__overlay__ {
			qdmabuf {
				compatible = "yuan,qdmabuf";
			};
		};
	};
};
